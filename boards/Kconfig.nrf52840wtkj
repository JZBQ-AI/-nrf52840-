## boards/nrf52840wtkj_defconfig
```kconfig
CONFIG_ARM_MPU=y
CONFIG_HW_STACK_PROTECTION=y

# 使能RTT
CONFIG_USE_SEGGER_RTT=y

# 使能 gpio
CONFIG_GPIO=y

#使能uart驱动
CONFIG_SERIAL=y

#使能 console
CONFIG_CONSOLE=y
CONFIG_UART_CONSOLE=y
CONFIG_RTT_CONSOLE=y

#使能日志
CONFIG_LOG=y
CONFIG_LOG_BACKEND_RTT=y
CONFIG_LOG_BACKEND_UART=y
```
